## Kconfig.projbuild
```kconfig
menu "MQTT Client Configuration"

    config WIFI_SSID
        string "WiFi SSID"
        default "YOUR_WIFI_SSID"
        help
            SSID (network name) for the ESP32 to connect to.

    config WIFI_PASSWORD
        string "WiFi Password"
        default "YOUR_WIFI_PASSWORD"
        help
            WiFi password (WPA or WPA2) for the network.

    config WIFI_MAXIMUM_RETRY
        int "Maximum WiFi retry"
        default 5
        help
            Maximum number of retries when connecting to WiFi.

    config MQTT_BROKER_URI
        string "MQTT Broker URI"
        default "mqtt://192.168.1.100:1883"
        help
            URI of the MQTT broker. Format: mqtt://host:port
            Examples:
            - mqtt://192.168.1.100:1883
            - mqtt://broker.hivemq.com:1883
            - mqtts://broker.emqx.io:8883 (for TLS)

    config MQTT_CLIENT_ID
        string "MQTT Client ID"
        default "esp32_bme680_sensor"
        help
            Client ID for the MQTT connection.
            Must be unique among all clients connecting to the broker.

    config MQTT_TOPIC_PREFIX
        string "MQTT Topic Prefix"
        default "sensor/bme680"
        help
            Prefix for all MQTT topics.
            Topics will be:
            - {prefix}/data    - Sensor data
            - {prefix}/iaq     - IAQ data
            - {prefix}/status  - Connection status
            - {prefix}/alert   - Alerts

    config MQTT_QOS
        int "MQTT QoS Level"
        default 1
        range 0 2
        help
            QoS level for MQTT messages:
            0 - At most once (fire and forget)
            1 - At least once (acknowledged delivery)
            2 - Exactly once (assured delivery)

    config MQTT_RETAIN_STATUS
        bool "Retain status messages"
        default y
        help
            If enabled, status messages will be retained by the broker.
            This allows new subscribers to immediately see the last status.

    config MQTT_USE_THINGSBOARD
        bool "Use ThingsBoard as MQTT backend"
        default n
        help
            If enabled, use ThingsBoard MQTT API (topic v1/devices/me/telemetry, username = access token).

    config MQTT_THINGSBOARD_ACCESS_TOKEN
        string "ThingsBoard Device Access Token"
        depends on MQTT_USE_THINGSBOARD
        default ""
        help
            Device access token from ThingsBoard. Used as MQTT username.

endmenu
```

## sdkconfig.defaults
```kconfig
# Target Configuration
CONFIG_IDF_TARGET="esp32c6"

# ESP32C6-Specific
CONFIG_ESP32C6_DEFAULT_CPU_FREQ_160=y

# I2C Configuration
CONFIG_I2C_ENABLE_DEBUG_LOG=n

# FreeRTOS Configuration
CONFIG_FREERTOS_HZ=1000

# Component config
CONFIG_ESPTOOLPY_FLASHSIZE_4MB=y

# Partition Table - Custom for larger app size (WiFi + MQTT)
CONFIG_PARTITION_TABLE_CUSTOM=y
CONFIG_PARTITION_TABLE_CUSTOM_FILENAME="partitions.csv"

# Serial flasher config
CONFIG_ESPTOOLPY_BAUD_921600B=y

# Log output
CONFIG_LOG_DEFAULT_LEVEL_INFO=y
CONFIG_LOG_MAXIMUM_LEVEL_VERBOSE=y

# Main task stack size (increased for WiFi and HTTP)
CONFIG_ESP_MAIN_TASK_STACK_SIZE=8192

# WiFi Configuration
CONFIG_ESP_WIFI_SSID="Hoanganhh"
CONFIG_ESP_WIFI_PASSWORD="250303hanh"

# MQTT Configuration
CONFIG_MQTT_USE_THINGSBOARD=y
CONFIG_MQTT_BROKER_URI="mqtt://10.143.203.27:1883"
CONFIG_MQTT_THINGSBOARD_ACCESS_TOKEN="3x50jua1ah34f5r3kfrx"

# LWIP Configuration
CONFIG_LWIP_LOCAL_HOSTNAME="esp32-env-monitor"

# HTTP Server Configuration
CONFIG_HTTPD_MAX_REQ_HDR_LEN=1024
CONFIG_HTTPD_MAX_URI_LEN=512

# NVS Configuration
CONFIG_NVS_ENCRYPTION=n
# NVS is enabled by default in ESP-IDF
# Default NVS partition size is sufficient for IAQ state persistence

# Power Management (optional - for energy saving)
# CONFIG_PM_ENABLE=y
# CONFIG_PM_DFS_INIT_AUTO=y
```
